## conf/layer.conf
```bitbake
# We have a conf and classes directory, append to BBPATH
BBPATH .= ":${LAYERDIR}"

# We have a recipes directory containing .bb and .bbappend files, add to BBFILES
BBFILES := "${BBFILES} ${LAYERDIR}/recipes*/*/*.bb \ 
            ${LAYERDIR}/recipes*/*/*.bbappend"

BBFILE_COLLECTIONS += "neutrino-mp"
BBFILE_PATTERN_neutrino-mp := "^${LAYERDIR}/"
BBFILE_PRIORITY_neutrino-mp = "10"

# we want the good jpeg lib, not the ijg stuff
PREFERRED_PROVIDER_jpeg ?= "libjpeg-turbo"

# ...and the good ffmpeg...
PREFERRED_PROVIDER_ffmpeg ?= "ffmpeg"
# to get this we need to...
LICENSE_FLAGS_WHITELIST ?= "commercial"

# kernel: debug commandline abused...
CMDLINE_DEBUG_raspberrypi = "console=tty0"
CMDLINE_DEBUG_raspberrypi2 = "console=tty0"

# Additional license directories.
LICENSE_PATH += "${LAYERDIR}/files/custom-licenses"

# hack to make sure that for spark target the correct qemu is available
# not in meta-stlinux, because native stuff can be shared across several targets
QEMU_TARGETS_append = " sh4"

# remove stuff that's most likely never needed.
# still configurable via conf/local.conf
NEUTRINO_DISTRO_DEBLOAT ?= "bluetooth irda pcmcia usbgadget zeroconf pci 3g nfc x11 opengl ptest multiarch wayland pulseaudio bluez5"
DISTRO_FEATURES_remove = "${NEUTRINO_DISTRO_DEBLOAT}"
```
